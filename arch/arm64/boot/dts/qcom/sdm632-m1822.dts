/dts-v1/;

#include "sdm632.dtsi"
#include "sdm450-pmi632.dtsi"
#include "sdm450-pmi632-mtp-s3.dtsi"

/ {
        model = "MTP S3 K81822AA1";
        compatible = "qcom,mtp";
        qcom,msm-name = "SDM632";
        qcom,board-id = <0x08 0x00>;
        qcom,msm-id = <0x15d 0x00>;
        qcom,pmic-id = <0x10016 0x25 0x00 0x00>;
        qcom,pmic-name = "PMI632";
};

#include "m1822/sdm632-m1822.dtsi"
